## configs/ls1046a-rdb_defconfig
```kconfig
BR2_aarch64=y
BR2_cortex_a72=y
BR2_TOOLCHAIN_EXTERNAL=y
BR2_TOOLCHAIN_EXTERNAL_CUSTOM=y
BR2_TOOLCHAIN_EXTERNAL_PATH="/opt/x-tools/aarch64-mono-linux-gnu/"
BR2_TOOLCHAIN_EXTERNAL_CUSTOM_PREFIX="arm-linux"
BR2_TOOLCHAIN_EXTERNAL_GCC_13=y
BR2_TOOLCHAIN_EXTERNAL_HEADERS_6_6=y
BR2_TOOLCHAIN_EXTERNAL_CUSTOM_GLIBC=y
# BR2_TOOLCHAIN_EXTERNAL_INET_RPC is not set
BR2_CCACHE=y
BR2_TARGET_GENERIC_HOSTNAME="ls1046a-rdb"
BR2_TARGET_GENERIC_ISSUE=""
BR2_INIT_SYSV=y
BR2_ROOTFS_DEVICE_CREATION_DYNAMIC_EUDEV=y
BR2_ROOTFS_MERGED_USR=y
BR2_SYSTEM_BIN_SH_ZSH=y
BR2_TARGET_TZ_INFO=y
BR2_ROOTFS_USERS_TABLES="$(BR2_EXTERNAL_MONO_FILESYSTEM_PATH)/board/freescale/ls1046a-rdb/users.txt"
BR2_ROOTFS_OVERLAY="$(BR2_EXTERNAL_MONO_FILESYSTEM_PATH)/board/freescale/ls1046a-rdb/rootfs_overlay"
BR2_ROOTFS_POST_BUILD_SCRIPT="$(BR2_EXTERNAL_MONO_FILESYSTEM_PATH)/board/freescale/ls1046a-rdb/post-build.sh"
BR2_LINUX_KERNEL=y
BR2_LINUX_KERNEL_CUSTOM_TARBALL=y
BR2_LINUX_KERNEL_CUSTOM_TARBALL_LOCATION="$(call github,nxp-qoriq,linux,lf-6.6.23-2.0.0)/lf-6.6.23-2.0.0.tar.gz"
BR2_LINUX_KERNEL_USE_CUSTOM_CONFIG=y
BR2_LINUX_KERNEL_CUSTOM_CONFIG_FILE="$(BR2_EXTERNAL_MONO_FILESYSTEM_PATH)/board/freescale/ls1046a-rdb/linux.config"
BR2_LINUX_KERNEL_DTS_SUPPORT=y
BR2_LINUX_KERNEL_INTREE_DTS_NAME="freescale/fsl-ls1046a-rdb-sdk"
BR2_LINUX_KERNEL_INSTALL_TARGET=y
BR2_PACKAGE_GZIP=y
BR2_PACKAGE_UNZIP=y
BR2_PACKAGE_FINDUTILS=y
BR2_PACKAGE_GIT=y
BR2_PACKAGE_GREP=y
BR2_PACKAGE_SED=y
BR2_PACKAGE_TREE=y
BR2_PACKAGE_MMC_UTILS=y
BR2_PACKAGE_QORIQ_FM_UCODE=y
BR2_PACKAGE_KBD=y
BR2_PACKAGE_LM_SENSORS=y
BR2_PACKAGE_LM_SENSORS_FANCONTROL=y
BR2_PACKAGE_CA_CERTIFICATES=y
BR2_PACKAGE_GNUTLS=y
BR2_PACKAGE_GNUTLS_OPENSSL=y
BR2_PACKAGE_GNUTLS_TOOLS=y
BR2_PACKAGE_SQLITE=y
BR2_PACKAGE_SQLITE_ENABLE_JSON1=y
BR2_PACKAGE_LIBCURL=y
BR2_PACKAGE_LIBCURL_CURL=y
BR2_PACKAGE_LIBSEMANAGE=y
BR2_PACKAGE_ARP_SCAN=y
BR2_PACKAGE_AVAHI=y
BR2_PACKAGE_BIND=y
BR2_PACKAGE_BIND_TOOLS=y
BR2_PACKAGE_BRIDGE_UTILS=y
BR2_PACKAGE_DHCP=y
BR2_PACKAGE_DHCP_SERVER=y
BR2_PACKAGE_DHCP_RELAY=y
BR2_PACKAGE_DHCP_CLIENT=y
BR2_PACKAGE_DHCPDUMP=y
BR2_PACKAGE_ETHTOOL=y
BR2_PACKAGE_FRR=y
BR2_PACKAGE_IFUPDOWN=y
BR2_PACKAGE_IGMPPROXY=y
BR2_PACKAGE_IPERF3=y
BR2_PACKAGE_IPROUTE2=y
BR2_PACKAGE_IPUTILS=y
BR2_PACKAGE_NET_TOOLS=y
BR2_PACKAGE_NETCAT=y
BR2_PACKAGE_NFTABLES=y
BR2_PACKAGE_NTPSEC=y
BR2_PACKAGE_NTPSEC_NTS=y
BR2_PACKAGE_OPENSSH=y
BR2_PACKAGE_OPENVPN=y
BR2_PACKAGE_RSYNC=y
BR2_PACKAGE_STRONGSWAN=y
BR2_PACKAGE_TCPDUMP=y
BR2_PACKAGE_TUNCTL=y
BR2_PACKAGE_UNBOUND=y
BR2_PACKAGE_WGET=y
BR2_PACKAGE_WHOIS=y
BR2_PACKAGE_WIREGUARD_TOOLS=y
BR2_PACKAGE_REFPOLICY=y
BR2_PACKAGE_BASH_COMPLETION=y
BR2_PACKAGE_TMUX=y
BR2_PACKAGE_COREUTILS=y
BR2_PACKAGE_DEBIANUTILS=y
BR2_PACKAGE_HTOP=y
BR2_PACKAGE_KMOD_TOOLS=y
BR2_PACKAGE_POLKIT=y
BR2_PACKAGE_PROCPS_NG=y
BR2_PACKAGE_TAR=y
BR2_PACKAGE_UTIL_LINUX_BINARIES=y
BR2_PACKAGE_UTIL_LINUX_AGETTY=y
BR2_PACKAGE_UTIL_LINUX_FSCK=y
BR2_PACKAGE_UTIL_LINUX_HWCLOCK=y
BR2_PACKAGE_UTIL_LINUX_LOGIN=y
BR2_PACKAGE_UTIL_LINUX_MORE=y
BR2_PACKAGE_UTIL_LINUX_MOUNT=y
BR2_PACKAGE_UTIL_LINUX_SULOGIN=y
BR2_PACKAGE_LESS=y
BR2_PACKAGE_NANO=y
BR2_PACKAGE_VIM=y
BR2_TARGET_ROOTFS_EXT2=y
BR2_TARGET_ROOTFS_EXT2_4=y
BR2_TARGET_ROOTFS_EXT2_SIZE="300M"
BR2_PACKAGE_HOST_QEMU=y
BR2_PACKAGE_HOST_QEMU_SYSTEM_MODE=y
BR2_PACKAGE_HOST_QEMU_VDE2=y
```
